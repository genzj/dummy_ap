## components/led/Kconfig
```kconfig
menu "LED Configuration"

    config LED_GPIO
        int "LED GPIO Pin"
        default 8
        help
            GPIO pin number for LED control.

    config LED_TIMER_ID
        int "LED Timer ID"
        default 1
        range 0 3
        help
            LEDC timer ID (0-3) for LED control.

    config LED_BLINK_SLOW_MS
        int "Slow Blink Period (ms)"
        default 1000
        help
            Time period in milliseconds for slow blink mode.

    config LED_BLINK_FAST_MS
        int "Fast Blink Period (ms)"
        default 200
        help
            Time period in milliseconds for fast blink mode.

    config LED_BREATH_FADE_MS
        int "Breath Fade Duration (ms)"
        default 3000
        help
            Fade duration in milliseconds for breathing effect.

    config LED_OUTPUT_INVERT
        bool "Enable GPIO output invert"
        default y
        help
            Enable GPIO output inversion for LED control.
            Set to 'y' if LED is pull-up (GPIO low = LED on).
            Set to 'n' if LED is pull-down (GPIO high = LED on).
            Pull-up ('y') is more common for its higher driven capacity.

endmenu
```

## components/protocol_examples_common/Kconfig.projbuild
```kconfig
menu "Example Connection Configuration"

    orsource "$IDF_PATH/examples/common_components/env_caps/$IDF_TARGET/Kconfig.env_caps"

    config EXAMPLE_WIFI_SSID
        string "WiFi SSID"
        default "dummy-ap"
        help
            SSID (network name) for the AP.

    config EXAMPLE_WIFI_PASSWORD
        string "WiFi Password"
        default "mypassword"
        help
            WiFi password (WPA or WPA2) for the ap to use.
            Can be left blank if the network has no security set.

    choice EXAMPLE_WIFI_AUTH_MODE
        prompt "WiFi AP auth mode"
        default EXAMPLE_WIFI_AUTH_OPEN
        help
            The authmode to use.

        config EXAMPLE_WIFI_AUTH_OPEN
            bool "OPEN"
        config EXAMPLE_WIFI_AUTH_WEP
            bool "WEP"
        config EXAMPLE_WIFI_AUTH_WPA_PSK
            bool "WPA PSK"
        config EXAMPLE_WIFI_AUTH_WPA2_PSK
            bool "WPA2 PSK"
        config EXAMPLE_WIFI_AUTH_WPA_WPA2_PSK
            bool "WPA WPA2 PSK"
        config EXAMPLE_WIFI_AUTH_WPA2_ENTERPRISE
            bool "WPA2 ENTERPRISE"
        config EXAMPLE_WIFI_AUTH_WPA3_PSK
            bool "WPA3 PSK"
        config EXAMPLE_WIFI_AUTH_WPA2_WPA3_PSK
            bool "WPA2 WPA3 PSK"
        config EXAMPLE_WIFI_AUTH_WAPI_PSK
            bool "WAPI PSK"
    endchoice
endmenu
```
